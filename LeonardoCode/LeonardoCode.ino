#include "U8glib.h"
#include <Keyboard.h>


U8GLIB_SSD1306_128X64 u8g(U8G_I2C_OPT_DEV_0 | U8G_I2C_OPT_NO_ACK | U8G_I2C_OPT_FAST); // Fast I2C / TWI

// 'base back', 128x64px
const unsigned char ABC [] PROGMEM = {
	0x3f, 0xff, 0xff, 0xff, 0xff, 0xff, 0xff, 0xff, 0xff, 0xff, 0xff, 0xff, 0xff, 0xff, 0xff, 0xfc, 
	0x60, 0x00, 0x00, 0x00, 0x00, 0x00, 0x00, 0x00, 0x00, 0x00, 0x00, 0x00, 0x00, 0x00, 0x00, 0x06, 
	0xc0, 0xf0, 0x00, 0x7e, 0x00, 0x07, 0xc0, 0x07, 0xc0, 0x03, 0xf8, 0x00, 0xfe, 0x00, 0x1f, 0x83, 
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	0x3f, 0xff, 0xff, 0xff, 0xff, 0xff, 0xff, 0xff, 0xff, 0xff, 0xff, 0xff, 0xff, 0xff, 0xff, 0xfc
};

char ABCD[] = "abcdefghijklmnopqrstuvwxyz";
#define POT A0
#define buttonPin 2


int cnt = 0;


bool ledState = false;
bool buttonPressed = false;

void setup() {
  u8g.setFont(u8g_font_tpssb);
  u8g.setColorIndex(1);

  Serial.begin(115200);

  pinMode(POT, INPUT);
  pinMode(LED_BUILTIN, OUTPUT);
  pinMode(buttonPin, INPUT_PULLUP);

}




void loop() {

  int buttonState = digitalRead(buttonPin);

    int cnt = map(analogRead(POT), 0, 1023, 0, 25);

    u8g.firstPage();
    do {
      if ((cnt >= 0) && (cnt < 7)) {
        u8g.drawFrame(5 + (17.5 * cnt), 0, 13, 14);
      } else if ((cnt >= 7) && (cnt < 14)) {
        u8g.drawFrame(5 + (17.5 * (cnt - 7)), 17, 13, 14);
      } else if ((cnt >= 14) && (cnt < 21)) {
        u8g.drawFrame(5 + (17.5 * (cnt - 14)), ((17 * 2) - 1), 13, 14);
      } else if ((cnt >= 21) && (cnt < 26)) {
        u8g.drawFrame(5 + (17.5 * (cnt - 20)), ((17 * 3) - 1), 13, 14);
      }

      u8g.drawBitmapP(0, 0, 128 / 8, 64, ABC);
    } while (u8g.nextPage());

  if (buttonState == LOW) {
    digitalWrite(LED_BUILTIN, HIGH);
		
    Keyboard.press(ABCD[cnt]);
  } else {
    digitalWrite(LED_BUILTIN, LOW);
    Keyboard.releaseAll();
  }

  delay(50);
}

