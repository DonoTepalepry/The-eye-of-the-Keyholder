#include "U8glib.h"

U8GLIB_SSD1306_128X64 u8g(U8G_I2C_OPT_DEV_0 | U8G_I2C_OPT_NO_ACK | U8G_I2C_OPT_FAST); // Fast I2C / TWI

// 'base back', 128x64px
const unsigned char ABC [] PROGMEM = {
	0x3f, 0xff, 0xff, 0xff, 0xff, 0xff, 0xff, 0xff, 0xff, 0xff, 0xff, 0xff, 0xff, 0xff, 0xff, 0xfc, 
	0x60, 0x00, 0x00, 0x00, 0x00, 0x00, 0x00, 0x00, 0x00, 0x00, 0x00, 0x00, 0x00, 0x00, 0x00, 0x06, 
	0xc0, 0xf0, 0x00, 0x7e, 0x00, 0x07, 0xc0, 0x07, 0xc0, 0x03, 0xf8, 0x00, 0xfe, 0x00, 0x1f, 0x83, 
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	0x3f, 0xff, 0xff, 0xff, 0xff, 0xff, 0xff, 0xff, 0xff, 0xff, 0xff, 0xff, 0xff, 0xff, 0xff, 0xfc
};


#define ENCODER_CLK 2
#define ENCODER_DT  3
#define ENCODER_BTN 4


volatile unsigned long lastEncoderInterrupt = 0;
const unsigned long encoderDebounceTime = 5;  // milliseconds


int cnt = 0;


bool ledState = false;
bool buttonPressed = false;

void setup() {
  u8g.setFont(u8g_font_tpssb);
  u8g.setColorIndex(1);

  Serial.begin(115200);

  pinMode(ENCODER_CLK, INPUT);
  pinMode(ENCODER_DT, INPUT);
  attachInterrupt(digitalPinToInterrupt(ENCODER_CLK), readEncoder, FALLING);

  pinMode(ENCODER_BTN, INPUT_PULLUP);
  pinMode(LED_BUILTIN, OUTPUT);
}

void readEncoder() {
  unsigned long currentMillis = millis();
  if (currentMillis - lastEncoderInterrupt > encoderDebounceTime) {
    int dtValue = digitalRead(ENCODER_DT);
    if (dtValue == HIGH) {
      cnt = cnt + 1;
    } else {
      cnt = cnt - 1;
    }
    lastEncoderInterrupt = currentMillis;
  }
}



void loop() {
  u8g.firstPage();
  do {
    if ((cnt >= 0) and (cnt < 7)){u8g.drawFrame(5 + (17.5*cnt), 0, 13, 14);}
    else if ((cnt >= 7) and (cnt < 14)){u8g.drawFrame(5 + (17.5*(cnt-7)), 17, 13, 14);}
    else if ((cnt >= 14) and (cnt < 21)){u8g.drawFrame(5 + (17.5*(cnt-14)), ((17*2)-1), 13, 14);}
    else if ((cnt >= 21) and (cnt < 26)){u8g.drawFrame(5 + (17.5*(cnt-20)), ((17*3)-1), 13, 14);}
    else if (cnt < 0){cnt = 25;}
    else if (cnt > 25){cnt = 0;}
      
      u8g.drawBitmapP(0,0,128/8,64,ABC);
  } while ( u8g.nextPage() );
  Serial.println(cnt);


  if (digitalRead(ENCODER_BTN) == LOW) {
    if (!buttonPressed) {
      ledState = !ledState;                          
      digitalWrite(LED_BUILTIN, ledState);           
      buttonPressed = true;                          
    }
  } else {
    buttonPressed = false;
  }

}
